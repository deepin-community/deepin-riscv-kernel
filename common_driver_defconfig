## gpu_driver_defconfig
```kconfig
##
## file: drivers/gpu/drm/Kconfig
##
CONFIG_DRM=m

##
## file: drivers/gpu/drm/amd/amdgpu/Kconfig
##
CONFIG_DRM_AMDGPU=m

##
## file: drivers/gpu/drm/radeon/Kconfig
##
CONFIG_DRM_RADEON=m

##
## file: drivers/gpu/drm/sun4i/Kconfig
##
CONFIG_DRM_SUN4I=m
```
